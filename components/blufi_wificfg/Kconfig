## components/blufi_wificfg/Kconfig
```kconfig
menu "Blufi WifiCfg Configuration"

    config BLUFI_WIFICFG_ENABLED
        bool "blufi wificfg"
        select BT_ENABLED
        help
            enable blufi wificfg

endmenu
```

## main/boards/doit-ai-01-kit-lcd/sdkconfig.defaults.board
```kconfig
CONFIG_BOARD_TYPE_DOIT_AI_01_KIT_LCD=y

CONFIG_ESPTOOLPY_FLASHSIZE_4MB=y
CONFIG_PARTITION_TABLE_CUSTOM_FILENAME="partitions/v1/4m.csv"
CONFIG_PARTITION_TABLE_FILENAME="partitions/v1/4m.csv"

CONFIG_IOT_PROTOCOL_XIAOZHI=y

CONFIG_ESP_WIFI_STATIC_RX_BUFFER_NUM=2
CONFIG_ESP_WIFI_RX_MGMT_BUF_NUM_DEF=4
CONFIG_ESP_WIFI_RX_BA_WIN=4
CONFIG_ESP_WIFI_TX_BA_WIN=4
CONFIG_LWIP_TCP_OVERSIZE_QUARTER_MSS=y
CONFIG_LWIP_TCP_SND_BUF_DEFAULT=4320
CONFIG_LWIP_TCP_WND_DEFAULT=4320
CONFIG_LWIP_TCPIP_RECVMBOX_SIZE=16
```

## main/boards/doit-ai-c5-kit-lcd/sdkconfig.defaults.board
```kconfig
CONFIG_BOARD_TYPE_DOIT_AI_C5_KIT_LCD=y


CONFIG_PARTITION_TABLE_CUSTOM=y
CONFIG_PARTITION_TABLE_CUSTOM_FILENAME="partitions/v1/4m.csv"
CONFIG_PARTITION_TABLE_FILENAME="partitions/v1/4m.csv"
CONFIG_PARTITION_TABLE_OFFSET=0x8000
CONFIG_ESPTOOLPY_FLASHSIZE_4MB=y


CONFIG_UI_STATUS_BAR_PAD=12

CONFIG_SPEAKING_FIRST_MUTE_TIME=60

CONFIG_VB6824_OTA_SUPPORT=y

CONFIG_VB6824_UART_PORT=0
CONFIG_ESP_CONSOLE_USB_SERIAL_JTAG=y #将uart0改为usb


CONFIG_ESP_COEX_SW_COEXIST_ENABLE=y
#CONFIG_ESP_COEX_EXTERNAL_COEXIST_ENABLE=y
#CONFIG_ESP_WIFI_11KV_SUPPORT=y
#CONFIG_ESP_WIFI_MBO_SUPPORT=y
#CONFIG_ESP_WIFI_WAPI_PSK=y
#CONFIG_ESP_WIFI_GCMP_SUPPORT=y

CONFIG_ESP_DEFAULT_CPU_FREQ_MHZ_240=y
CONFIG_ESP_WIFI_STATIC_RX_BUFFER_NUM=8
CONFIG_ESP_WIFI_DYNAMIC_RX_BUFFER_NUM=16
CONFIG_ESP_WIFI_RX_BA_WIN=8
CONFIG_LWIP_TCPIP_RECVMBOX_SIZE=16
CONFIG_MBEDTLS_DYNAMIC_FREE_CONFIG_DATA=y
CONFIG_ESP_WIFI_RX_IRAM_OPT=y
CONFIG_ESP_WIFI_EXTRA_IRAM_OPT=y
#CONFIG_ESP_WIFI_IRAM_OPT=y

CONFIG_COMPILER_OPTIMIZATION_PERF=y
```

## sdkconfig.defaults.esp32c2
```kconfig
CONFIG_ESPTOOLPY_FLASHSIZE_4MB=y

CONFIG_PARTITION_TABLE_CUSTOM=y
CONFIG_PARTITION_TABLE_CUSTOM_FILENAME="partitions/v1/4m_ota.csv"
CONFIG_PARTITION_TABLE_FILENAME="partitions/v1/4m_ota.csv"
CONFIG_PARTITION_TABLE_OFFSET=0x8000

CONFIG_XTAL_FREQ_26=y

CONFIG_FREERTOS_IDLE_TASK_STACKSIZE=768
CONFIG_FREERTOS_TIMER_TASK_STACK_DEPTH=1536
CONFIG_SYSTEM_EVENT_TASK_STACK_SIZE=2560
CONFIG_IPC_TASK_STACK_SIZE=1024
CONFIG_TIMER_TASK_STACK_SIZE=2048
CONFIG_ESP_MAIN_TASK_STACK_SIZE=4096

CONFIG_MQTT_USE_CUSTOM_CONFIG=y
CONFIG_MQTT_TASK_STACK_SIZE=3584

CONFIG_ESP_WIFI_STATIC_RX_BUFFER_NUM=3
CONFIG_ESP_WIFI_DYNAMIC_RX_BUFFER_NUM=6
CONFIG_ESP_WIFI_RX_BA_WIN=3
CONFIG_MBEDTLS_DYNAMIC_FREE_CONFIG_DATA=y
CONFIG_ESP_WIFI_ENABLE_WPA3_SAE=n
CONFIG_ESP_WIFI_ESPNOW_MAX_ENCRYPT_NUM=0
CONFIG_LWIP_IPV6=n
CONFIG_LWIP_TCPIP_RECVMBOX_SIZE=16
```

## sdkconfig.defaults.esp32c3
```kconfig
CONFIG_ESPTOOLPY_FLASHSIZE_8MB=y

CONFIG_PARTITION_TABLE_CUSTOM=y
CONFIG_PARTITION_TABLE_CUSTOM_FILENAME="partitions/v1/8m.csv"
CONFIG_PARTITION_TABLE_FILENAME="partitions/v1/8m.csv"
CONFIG_PARTITION_TABLE_OFFSET=0x8000

CONFIG_ESP_WIFI_STATIC_RX_BUFFER_NUM=3
CONFIG_ESP_WIFI_DYNAMIC_RX_BUFFER_NUM=6
CONFIG_ESP_WIFI_RX_BA_WIN=3
CONFIG_MBEDTLS_DYNAMIC_FREE_CONFIG_DATA=y
CONFIG_ESP_WIFI_ENABLE_WPA3_SAE=n
CONFIG_ESP_WIFI_ESPNOW_MAX_ENCRYPT_NUM=0
CONFIG_FREERTOS_IDLE_TASK_STACKSIZE=768
CONFIG_LWIP_IPV6=n
CONFIG_LWIP_TCPIP_RECVMBOX_SIZE=16
```
